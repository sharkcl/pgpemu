## pgpemu-esp32/sdkconfig.defaults
```kconfig
# Override some defaults so BT stack is enabled
# in this example

#
# BT config
#
CONFIG_BT_ENABLED=y

#
# ESP32-specific config
#
CONFIG_ESP32_ENABLE_STACK_BT=y
# CONFIG_ESP32_ENABLE_STACK_NONE is not set
CONFIG_MEMMAP_BT=y
CONFIG_BT_BLE_42_FEATURES_SUPPORTED=y
CONFIG_FREERTOS_ENABLE_BACKWARD_COMPATIBILITY=y
```
